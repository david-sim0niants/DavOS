#include <ld/ldsym.h>
#include <config.h>

ENTRY(_start)

SECTIONS
{
	. = 1M;

	.text : ALIGN(4K)
	{
		KEEP(*(.multiboot_header))
		*(.text)
		*(.text.*)
	}

	.bss (NOLOAD) : ALIGN(4K)
	{
		*(.bss)
	}

	.rodata : ALIGN(4K)
	{
		*(.rodata)
		*(.rodata.*)
	}

#include "entry_common_ldsym.ld.h"

	.data : ALIGN(4K)
	{
		*(.data)
	}

	.stack BLOCK(CONFIG_STACK_SIZE) (NOLOAD) : ALIGN(4K)
	{
		. += CONFIG_STACK_SIZE;
	}

	PROVIDE(__STACK_TOP = .);
	PROVIDE(__KERNEL_START_PLACEHOLDER = .);

	.kernel_start_placeholder :
	{
		KEEP(*(.kernel_start_placeholder))
	}

	PROVIDE(__KERNEL_PLACEHOLDER_SIZE = . - __KERNEL_START_PLACEHOLDER);

	/DISCARD/ :
	{
		*(.note.*)
		*(.comment)
		*(.eh_frame)
	}
}
