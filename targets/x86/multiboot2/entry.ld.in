#include <ld/ldsym.h>
#include <config.h>

ENTRY(_start)

SECTIONS
{
	. = 1M;

	.i386.text : ALIGN(4K)
	{
		KEEP(*(.i386.text));
	}

	_start = ADDR(.i386.text);

	.i386.bss (NOLOAD) : ALIGN(4K)
	{
		QUAD(0)
	}

	.i386.rodata : ALIGN(4K)
	{
		KEEP(*(.i386.rodata));
	}

#include "entry_common_ldsym.ld.h"

	.i386.data : ALIGN(4K)
	{
		KEEP(*(.i386.data));
	}

	.stack BLOCK(CONFIG_STACK_SIZE) (NOLOAD) : ALIGN(4K)
	{
		. += CONFIG_STACK_SIZE;
	}

	PROVIDE(__STACK_TOP = .);
	PROVIDE(__KERNEL_START_PLACEHOLDER = .);

	.kernel_start_placeholder :
	{
		KEEP(*(.kernel_start_placeholder));
	}

	PROVIDE(__KERNEL_PLACEHOLDER_SIZE = . - __KERNEL_START_PLACEHOLDER);

	/DISCARD/ :
	{
		*(.note.*)
		*(.comment)
		*(.eh_frame)
	}
}
